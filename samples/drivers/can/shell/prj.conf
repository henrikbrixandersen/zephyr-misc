## CMakeLists.txt
```
# Copyright (c) 2023 Henrik Brix Andersen <henrik@brixandersen.dk>
# SPDX-License-Identifier: Apache-2.0

cmake_minimum_required(VERSION 3.20.0)

find_package(Zephyr REQUIRED HINTS $ENV{ZEPHYR_BASE})
project(can_shell)

FILE(GLOB app_sources src/*.c)
target_sources(app PRIVATE ${app_sources})
```

## sample.yaml
```
sample:
  name: CAN shell sample
tests:
  sample.drivers.can.shell:
    tags: can shell
    harness: keyboard
```

## prj.conf
```kconfig
CONFIG_ASSERT=y
CONFIG_LOG=y
CONFIG_SHELL=y
CONFIG_SHELL_ARGC_MAX=72
CONFIG_STATS=y
CONFIG_STATS_SHELL=y
CONFIG_CAN=y
CONFIG_CAN_LOG_LEVEL_DBG=y
CONFIG_CAN_FD_MODE=y
CONFIG_CAN_RX_TIMESTAMP=y
CONFIG_CAN_SHELL=y
CONFIG_CAN_STATS=y
```

## boards/nucleo_g474re.overlay
```dts
/*
 * Copyright (c) 2023 Henrik Brix Andersen <henrik@brixandersen.dk>
 * SPDX-License-Identifier: Apache-2.0
 */

&can2 {
	pinctrl-0 = <&fdcan2_rx_pb5 &fdcan2_tx_pb6>;
	pinctrl-names = "default";
	bus-speed = <125000>;
	bus-speed-data = <1000000>;
	status = "okay";
};

&can3 {
	pinctrl-0 = <&fdcan3_rx_pb3 &fdcan3_tx_pb4>;
	pinctrl-names = "default";
	bus-speed = <125000>;
	bus-speed-data = <1000000>;
	status = "okay";
};
```

## src/main.c
```c
/*
 * Copyright (c) 2023 Henrik Brix Andersen <henrik@brixandersen.dk>
 *
 * SPDX-License-Identifier: Apache-2.0
 */
```
