## boards/shields/arduino_eeproms/Kconfig.defconfig
```kconfig
# Copyright (c) 2021 Henrik Brix Andersen <henrik@brixandersen.dk>
# SPDX-License-Identifier: Apache-2.0

if SHIELD_ARDUINO_EEPROMS

config SPI
	default y

config I2C
	default y

config EEPROM
	default y

config EEPROM_AT24
	default y

config EEPROM_AT25
	default y

endif # SHIELD_ARDUINO_EEPROMS
```

## boards/shields/arduino_eeproms/Kconfig.shield
```kconfig
# Copyright (c) 2021 Henrik Brix Andersen <henrik@brixandersen.dk>
# SPDX-License-Identifier: Apache-2.0

config SHIELD_ARDUINO_EEPROMS
        def_bool $(shields_list_contains,arduino_eeproms)
```

## boards/shields/arduino_lm77/Kconfig.defconfig
```kconfig
# Copyright (c) 2021 Henrik Brix Andersen <henrik@brixandersen.dk>
# SPDX-License-Identifier: Apache-2.0

if SHIELD_ARDUINO_LM77

config I2C
	default y

config SENSOR
	default y

config LM77
	default y

endif # SHIELD_ARDUINO_LM77
```

## boards/shields/arduino_lm77/Kconfig.shield
```kconfig
# Copyright (c) 2021 Henrik Brix Andersen <henrik@brixandersen.dk>
# SPDX-License-Identifier: Apache-2.0

config SHIELD_ARDUINO_LM77
        def_bool $(shields_list_contains,arduino_lm77)
```

## boards/shields/frdm_k64f_canbus/Kconfig.shield
```kconfig
# Copyright (c) 2022 Henrik Brix Andersen <henrik@brixandersen.dk>
# SPDX-License-Identifier: Apache-2.0

config SHIELD_FRDM_K64F_CANBUS
        def_bool $(shields_list_contains,frdm_k64f_canbus)
```

## boards/shields/stm32f3_disco_canbus/Kconfig.shield
```kconfig
# Copyright (c) 2022 Henrik Brix Andersen <henrik@brixandersen.dk>
# SPDX-License-Identifier: Apache-2.0

config SHIELD_STM32F3_DISCO_CANBUS
        def_bool $(shields_list_contains,stm32f3_disco_canbus)
```
